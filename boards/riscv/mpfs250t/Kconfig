## boards/riscv/mpfs250t/Kconfig
```kconfig
# Icicle board configuration

# Copyright (c) 2020 Tobias Svehagen
# SPDX-License-Identifier: Apache-2.0

config BOARD_USE_DDR
	bool "Enable running in DDR instead of LIM"
	select SOC_ICICLE_IN_DDR
	default n
	depends on BOARD_MPFS250T
	
config BOARD_HART_TO_USE
	int "Select single Hart to run Zephyr on"
	range 0 4
	default 1
	depends on BOARD_MPFS250T
	
	
```

## boards/riscv/mpfs250t/Kconfig.defconfig
```kconfig
# SPDX-License-Identifier: Apache-2.0

config BOARD
	default "mpfs250t"
	depends on BOARD_MPFS250T
```

## soc/riscv/riscv-privilege/Kconfig
```kconfig
# Configuration options for riscv SOCs supporting the riscv privileged
# architecture specification

# Copyright (c) 2017 Jean-Paul Etienne <fractalclone@gmail.com>
# SPDX-License-Identifier: Apache-2.0

config SOC_FAMILY_RISCV_PRIVILEGE
	bool

config SOC_FAMILY
	string
	default "riscv-privilege"
	depends on SOC_FAMILY_RISCV_PRIVILEGE

config RISCV_HAS_PLIC
	bool "Does the SOC provide support for a Platform Level Interrupt Controller (PLIC)"
	depends on SOC_FAMILY_RISCV_PRIVILEGE
	help
	  Does the SOC provide support for a Platform Level Interrupt Controller (PLIC).

config RISCV_HAS_CLIC
	bool "Does the SOC provide support for a Core-Local Interrupt Controller (CLIC)"
	depends on SOC_FAMILY_RISCV_PRIVILEGE
	help
	  Does the SOC provide support for a Core-Local Interrupt Controller (CLIC).

config RISCV_MTVEC_VECTORED_MODE
	bool "Should the SOC use mtvec in vectored mode"
	depends on SOC_FAMILY_RISCV_PRIVILEGE
	help
	  Should the SOC use mtvec in vectored mode

config RV_MP_TOTAL_NUM_CPUS
	int "Total number of CPUs/cores"
	default 1
	range 1 5
	help
	  Number of cores in the system including those not used by Zephyr.

config RV_BASE_CPU
	int "Starting CPU number"
	default 0
	help
	  This option sets the starting cpu id for the SMP core.
	  For RISC-V systems such as MPFS and FU540 this would be set to 1 to
	  skip the E51 hart 0 as it is not usable in SMP configurations.
	  This can also be used in conjunction with MP_NUM_CPUS to select a
	  subset of available CPUs to use for Zephyr.

source "soc/riscv/riscv-privilege/*/Kconfig.soc"
```

## soc/riscv/riscv-privilege/icicle/Kconfig.soc
```kconfig
# RISCV64_MIV configuration options

# Copyright (c) 2018 Antmicro <www.antmicro.com>
# SPDX-License-Identifier: Apache-2.0

choice
	prompt "Microsemi ICICI system implementation"
	depends on SOC_SERIES_RISCV64_MIV

config SOC_RISCV64_MIV
	bool "Microsemi ICICLE system implementation"
	select ATOMIC_OPERATIONS_C

endchoice

config SOC_ICICLE_IN_DDR
	bool
	help
	  Locate the application image in DDR instead of in the LIM.
```

## zephyr/boards/riscv/mpfs250t/Kconfig.board
```kconfig
# SPDX-License-Identifier: Apache-2.0

config BOARD_MPFS250T
	bool "Microsemi PolarFire SoC ICICLE kit"
	depends on SOC_RISCV64_MIV
	select 64BIT
```

## zephyr/boards/riscv/mpfs_icicle/mpfs_icicle_defconfig
```kconfig
# Copyright (c) 2020-2021 Microchip Technology Inc
# SPDX-License-Identifier: Apache-2.0

CONFIG_SOC_SERIES_RISCV64_MIV=y
CONFIG_SOC_MPFS=y
CONFIG_MPFS_HAL=n
CONFIG_BASE64=y
CONFIG_INCLUDE_RESET_VECTOR=y
CONFIG_BOARD_MPFS_ICICLE=y
CONFIG_NO_OPTIMIZATIONS=y
CONFIG_CONSOLE=y
CONFIG_SERIAL=y
CONFIG_UART_CONSOLE=y
CONFIG_RISCV_SOC_INTERRUPT_INIT=y
CONFIG_RISCV_HAS_PLIC=y
CONFIG_XIP=n
CONFIG_INIT_STACKS=y
CONFIG_SYS_CLOCK_TICKS_PER_SEC=1000
CONFIG_FPU=n
# GPIO driver options
CONFIG_GPIO=y
CONFIG_HAS_MONITOR_HART=y
CONFIG_SMP=y
CONFIG_RV_BASE_CPU=1
CONFIG_MP_NUM_CPUS=4
CONFIG_MP_MAX_NUM_CPUS=4
CONFIG_RV_MP_TOTAL_NUM_CPUS=5
```
